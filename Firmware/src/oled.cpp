#include <Arduino.h>
#include <Wire.h>
#include <string.h>
#include "oled.h"

static uint8_t  g_addr = 0x3D;
static uint8_t  fb[1024];   // 128 x 64 / 8, page-major: fb[page*128 + col]

// Classic 5x7 font, ASCII 0x20..0x7E. Each glyph = 5 column bytes (bit0 = top).
static const uint8_t FONT5x7[][5] = {
    {0x00,0x00,0x00,0x00,0x00}, // ' '
    {0x00,0x00,0x5F,0x00,0x00}, // !
    {0x00,0x07,0x00,0x07,0x00}, // "
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    {0x08,0x04,0x08,0x10,0x08}, // ~
};

static void cmd(uint8_t c) {
    Wire.beginTransmission(g_addr);
    Wire.write((uint8_t)0x00);   // control byte: command
    Wire.write(c);
    Wire.endTransmission();
}

bool oledBegin(uint8_t addr7) {
    g_addr = addr7;
    // SH1106 128x64 init.
    cmd(0xAE);              // display off
    cmd(0xD5); cmd(0x80);   // clock divide / osc freq
    cmd(0xA8); cmd(0x3F);   // multiplex ratio = 64
    cmd(0xD3); cmd(0x00);   // display offset 0
    cmd(0x40);              // start line 0
    cmd(0xAD); cmd(0x8B);   // DC-DC control: internal DC-DC ON (SH1106)
    cmd(0xA1);              // segment remap (column 127 -> SEG0)
    cmd(0xC8);              // COM scan direction: reversed
    cmd(0xDA); cmd(0x12);   // COM pins config
    cmd(0x81); cmd(0xCF);   // contrast
    cmd(0xD9); cmd(0x22);   // pre-charge period
    cmd(0xDB); cmd(0x40);   // VCOMH deselect level
    cmd(0xA4);              // resume: follow RAM content
    cmd(0xA6);              // normal (not inverted)
    cmd(0xAF);              // display on
    delay(100);             // let the panel's DC-DC settle
    oledClear();
    oledShow();
    return true;
}

void oledClear() {
    memset(fb, 0, sizeof(fb));
}

void oledText(uint8_t x, uint8_t page, const char *s) {
    if (page > 7) return;
    while (*s && x < 128) {
        uint8_t ch = (uint8_t)*s++;
        if (ch < 0x20 || ch > 0x7E) ch = 0x20;
        const uint8_t *g = FONT5x7[ch - 0x20];
        for (int i = 0; i < 5 && x < 128; i++) fb[page * 128 + x++] = g[i];
        if (x < 128) fb[page * 128 + x++] = 0x00;   // 1px inter-char gap
    }
}

void oledShow() {
    for (uint8_t page = 0; page < 8; page++) {
        cmd(0xB0 | page);   // set page address
        cmd(0x02);          // lower column = 2 (SH1106 RAM is offset by 2)
        cmd(0x10);          // higher column = 0
        Wire.beginTransmission(g_addr);
        Wire.write((uint8_t)0x40);   // control byte: data
        Wire.write(&fb[page * 128], 128);
        Wire.endTransmission();
    }
}
